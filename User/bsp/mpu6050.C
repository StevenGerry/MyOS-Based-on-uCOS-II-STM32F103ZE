#include "stm32f10x.h"
#include "mpu6050.h" 
#include "user_usart.h"
#include "delay.h"

/**************************************************************************************
 * 描  述 : 初始化MPU6050用IIC所用到的IO口
 * 入  参 : 无
 * 返回值 : 无
 **************************************************************************************/
void MPU6050_IIC_Init(void)
{
  GPIO_InitTypeDef  GPIO_InitStructure;

  //打开所用GPIO的时钟
  RCC_APB2PeriphClockCmd( RCC_APB2Periph_GPIOB , ENABLE); 
  
  //配置的IO是PB10 PB11，SPI的SCL SDA
	GPIO_InitStructure.GPIO_Pin = GPIO_Pin_10 | GPIO_Pin_11 ;                
	GPIO_InitStructure.GPIO_Speed = GPIO_Speed_50MHz;
	GPIO_InitStructure.GPIO_Mode = GPIO_Mode_Out_OD;           //开漏输出
	GPIO_Init(GPIOB, &GPIO_InitStructure);
}

/**************************************************************************************
 * 描  述 : 模拟IIC总线产生启动信号
 * 入  参 : 无
 * 返回值 : 无
 **************************************************************************************/
void IIC_Start(void)
{
  IIC_SDA_1;                    //拉高数据线
  IIC_SCL_1;                    //拉高时钟线
  sw_delay_us(4);               //延时
  IIC_SDA_0;                    //当SCL高电平时，SDA出现一个下跳沿表示I2C总线启动信号
  sw_delay_us(4);               //延时
  IIC_SCL_0;                    //拉低时钟线
  sw_delay_us(4);
}

/**************************************************************************************
 * 描  述 : 模拟IIC总线产生停止信号
 * 入  参 : 无
 * 返回值 : 无
 **************************************************************************************/
void IIC_Stop(void)
{
  IIC_SDA_0;                    //拉低数据线
  IIC_SCL_1;                    //拉高时钟线
  sw_delay_us(4);               //延时
  IIC_SDA_1;                    //当SCL高电平时，SDA出现一个上跳沿表示IIC总线停止信号
  sw_delay_us(4);               //延时
}

/**************************************************************************************
 * 描  述 : 产生IIC应答信号
 * 入  参 : ack (0:产生ACK应答信号 1:产生NACK应答信号)
 * 返回值 : 无
 **************************************************************************************/
void IIC_SendACK(uint8_t ack)
{
    if(ack)
    {
       IIC_SDA_1;                //拉高数据线
    }
    else
    {
       IIC_SDA_0;                //拉低数据线
    }
    IIC_SCL_1;                   //拉高时钟线
    sw_delay_us(4);              //延时
    IIC_SCL_0;                   //拉低时钟线
    sw_delay_us(4);              //延时
}

/**************************************************************************************
 * 描  述 : IIC接收应答信号
 * 入  参 : 无
 * 返回值 : 1，接收应答失败；0，接收应答成功
 **************************************************************************************/
uint8_t IIC_RecvACK(void)
{
  uint8_t temp;
  
  IIC_SCL_1;                    //拉高时钟线
  sw_delay_us(4);               //延时
  if (IIC_SDA_READ)	            //读取SDA口线状态
	{
		temp = 1;
	}
	else
	{
		temp = 0;
	}
  IIC_SCL_0;                    //拉低时钟线
  sw_delay_us(4);               //延时
  return temp;
}

/**************************************************************************************
 * 描  述 : 字节数据发送函数
 * 入  参 : dat，可以是地址，也可以是数据
 * 返回值 : 无
 **************************************************************************************/
void IIC_SendByte(uint8_t dat)
{
  uint8_t i;
  for (i=0; i<8; i++)          //先发送字节的高位bit7 
  {
     if (dat & 0x80)
		 {
			  IIC_SDA_1;
		  }
		 else
		  {
			   IIC_SDA_0;
		   }
      dat <<= 1;               //移出数据的最高位
      IIC_SCL_1;               //拉高时钟线
      sw_delay_us(4);          //延时
      IIC_SCL_0;               //拉低时钟线
      sw_delay_us(4);          //延时
   }
   IIC_RecvACK();
}

/**************************************************************************************
 * 描  述 : 字节数据接收函数
 * 入  参 : 无
 * 返回值 : 接收到的一个字节的数据
 **************************************************************************************/
uint8_t IIC_RecvByte()
{
  uint8_t i;
  uint8_t dat = 0;
  
  IIC_SDA_1;                    //使能内部上拉,准备读取数据,
  for (i=0; i<8; i++)           //8位计数器
  {
     dat <<= 1;                 //左移一个bit
     IIC_SCL_1;                 //拉高时钟线
     sw_delay_us(4);            //延时
     if(IIC_SDA_READ)	          //读取SDA口线状态
		 {
			 dat++;                   //读数据     
		  }         
      IIC_SCL_0;                //拉低时钟线
      sw_delay_us(4);           //延时
    }
    return dat;
}

/**************************************************************************************
 * 描  述 : 向IIC设备写入一个字节数据
 * 入  参 : 寄存器地址，待写入寄存器的数据
 * 返回值 : 无
 **************************************************************************************/
void Single_WriteIIC(uint8_t REG_Address,uint8_t REG_data)
{
    IIC_Start();                  //起始信号
    IIC_SendByte(SlaveAddress);   //发送设备地址+写信号
    IIC_SendByte(REG_Address);    //内部寄存器地址，
    IIC_SendByte(REG_data);       //内部寄存器数据，
    IIC_Stop();                   //发送停止信号
}

/**************************************************************************************
 * 描  述 : 从I2C设备读取一个字节数据
 * 入  参 : 寄存器地址
 * 返回值 : 从寄存器待读出的数据
 **************************************************************************************/
uint8_t Single_ReadIIC(uint8_t REG_Address)
{
	uint8_t REG_data;
	IIC_Start();                   //起始信号
	IIC_SendByte(SlaveAddress);    //发送设备地址+写信号
	IIC_SendByte(REG_Address);     //发送存储单元地址，从0开始	
	IIC_Start();                   //起始信号
	IIC_SendByte(SlaveAddress+1);  //发送设备地址+读信号
	REG_data=IIC_RecvByte();       //读出寄存器数据
	IIC_SendACK(1);                //接收应答信号
	IIC_Stop();                    //停止信号
	return REG_data;
}

/**************************************************************************************
 * 描  述 : 初始化MPU6050
 * 入  参 : 无
 * 返回值 : 无
 **************************************************************************************/
void InitMPU6050(void)
{
  MPU6050_IIC_Init();                     //初始化MPU6050用IIC所用到的IO口
  
	Single_WriteIIC(PWR_MGMT_1, 0x00);	    //解除休眠状态
	Single_WriteIIC(SMPLRT_DIV, 0x07);
	Single_WriteIIC(CONFIG, 0x06);
	Single_WriteIIC(GYRO_CONFIG, 0x18);
	Single_WriteIIC(ACCEL_CONFIG, 0x01);
}

/**************************************************************************************
 * 描  述 : 合成字节函数
 * 入  参 : 待操作寄存器地址
 * 返回值 : 将寄存器两次读取的数据合成2个字节的数据
 **************************************************************************************/
int16_t GetData(uint8_t REG_Address)
{
	uint8_t H,L;
	H=Single_ReadIIC(REG_Address);
	L=Single_ReadIIC(REG_Address+1);
	return ((H<<8)+L);                     //合成数据
}

/**************************************************************************************
 * 描  述 : 发送16位有符号变量
 * 入  参 : 16位有符号变量
 * 返回值 : 无
 **************************************************************************************/
void USART_TrData(int16_t data)
{ 
  uint8_t i,temp[5];
	if(data<0)
	{
		USART1_SendByte(45);                            //发送“-”
    data=-data;
	}
	else
  {
    USART1_SendByte(32);                            //发送“ ”
  }   
  
  //提取data数据到temp数组中
  temp[0]=data/10000+0x30;                          //万位数提取并转成ASCII码
  temp[1]=(data%10000)/1000+0x30;                   //千位数提取并转成ASCII码
  temp[2]=((data%10000)%1000)/100+0x30;             //百位数提取并转成ASCII码
  temp[3]=(((data%10000)%1000)%100)/10+0x30;        //十位数提取并转成ASCII码
  temp[4]=(((data%10000)%1000)%100)%10+0x30;        //个位数提取并转成ASCII码
  
  //发送temp数组内容
  for(i=0;i<5;i++)                                  
  {
    USART1_SendByte(temp[i]);  
  }
}
